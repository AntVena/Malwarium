// dump_content.cpp — print the firmware's content tables as JSON, for the web 'Pedia.
//
// The site's data file is generated by tools/gen_pedia_data.py. That generator used to
// read the tables by regex, indexing each row's fields BY POSITION — which meant
// reordering a field in ItemDef/ModDef/MoveDef silently shifted what the site
// published, and description text arrived as a raw `{mag}` template the generator
// would have had to expand itself, in a second implementation that could disagree with
// the firmware's.
//
// So the firmware answers instead: this tool links the real tables and the real
// expander (core/content/effect_text.h) and prints what the device would show —
// descriptions already substituted, plus each row's derived stat line. The generator
// consumes this and never parses C++.
//
// Deliberately narrow: it needs the content tables and effect_text, nothing else —
// no framebuffer, no assets, no engine. That is why `make pedia` compiles it directly
// (repo-root Makefile) rather than linking the whole malcore library, and why it runs
// anywhere a C++17 compiler does.
//
//   ./dump_content            -> the JSON on stdout
#include <cstdio>
#include <cstring>

#include "core/app/game_achievements.h"   // achievementTrigger/Goal — kGoalAll resolution
#include "core/content/areas/area_defs.h"
#include "core/content/content_achievements.h"
#include "core/content/content_recipes.h"
#include "core/content/content_tables.h"
#include "core/content/creatures/creature_lines.h"
#include "core/content/effect_text.h"

using namespace mal;

namespace {

// JSON string escape. The tables hold UTF-8 prose (em dashes, ellipses); those bytes
// pass through untouched — only the structural characters and control bytes need care.
void jstr(const char* s) {
    std::putchar('"');
    for (const unsigned char* p = reinterpret_cast<const unsigned char*>(s ? s : "");
         *p; ++p) {
        switch (*p) {
            case '"': std::fputs("\\\"", stdout); break;
            case '\\': std::fputs("\\\\", stdout); break;
            case '\n': std::fputs("\\n", stdout); break;
            case '\r': std::fputs("\\r", stdout); break;
            case '\t': std::fputs("\\t", stdout); break;
            default:
                if (*p < 0x20) std::printf("\\u%04x", *p);
                else std::putchar(*p);
        }
    }
    std::putchar('"');
}

void field(const char* key, const char* val, bool comma = true) {
    jstr(key);
    std::fputs(": ", stdout);
    jstr(val);
    if (comma) std::fputs(", ", stdout);
}

void fieldInt(const char* key, int val, bool comma = true) {
    jstr(key);
    std::printf(": %d%s", val, comma ? ", " : "");
}

void fieldBool(const char* key, bool val, bool comma = true) {
    jstr(key);
    std::printf(": %s%s", val ? "true" : "false", comma ? ", " : "");
}

const char* itemTypeKey(ItemDef::Type t) {
    switch (t) {
        case ItemDef::Type::Food: return "FOOD";
        case ItemDef::Type::Buff: return "BUFFS";
        case ItemDef::Type::Quest: return "QUEST";
    }
    return "QUEST";
}

const char* contextKey(ItemDef::Context c) {
    switch (c) {
        case ItemDef::Context::Anytime: return "Anytime";
        case ItemDef::Context::LockoutOnly: return "LockoutOnly";
        case ItemDef::Context::PreEncounter: return "PreEncounter";
    }
    return "Anytime";
}

const char* useKey(ItemDef::Use u) {
    switch (u) {
        case ItemDef::Use::Consume: return "Consume";
        case ItemDef::Use::OpenContainer: return "OpenContainer";
        case ItemDef::Use::Rollback: return "Rollback";
        case ItemDef::Use::DecryptEgg: return "DecryptEgg";
        case ItemDef::Use::PlayCryptogram: return "PlayCryptogram";
    }
    return "Consume";
}

const char* stageKey(Stage s) {
    switch (s) {
        case Stage::BootSector: return "BootSector";
        case Stage::Process: return "Process";
        case Stage::Script: return "Script";
        case Stage::Daemon: return "Daemon";
    }
    return "BootSector";
}

// A nullptr id field is meaningful (no line, no successor) — emit JSON null, not "".
void fieldIdOrNull(const char* key, const char* val, bool comma = true) {
    jstr(key);
    std::fputs(": ", stdout);
    if (val) jstr(val);
    else std::fputs("null", stdout);
    if (comma) std::fputs(", ", stdout);
}

void dumpCreatures() {
    std::fputs("\"creatures\": [\n", stdout);
    // Family by family, in kCreatureLines order — the roster has no flat form, and
    // this order is what the 'Pedia lists species in.
    int i = 0;
    for (const CreatureLine& line : kCreatureLines)
    for (int r = 0; r < line.count; ++r, ++i) {
        const CreatureDef& c = line.rows[r];
        std::fputs("  {", stdout);
        field("id", c.id);
        field("name", c.displayName);
        field("stage", stageKey(c.stage));
        field("sprite", c.spriteName);
        fieldIdOrNull("evolvesToId", c.evolvesToId);
        fieldIdOrNull("evolvesToGoodId", c.evolvesToGoodId);
        fieldIdOrNull("evolvesToBadId", c.evolvesToBadId);
        fieldIdOrNull("evolvesToTrojanId", c.evolvesToTrojanId);
        fieldInt("powerMultPct", c.powerMultPct);
        fieldInt("fragMultPct", c.fragMultPct);
        fieldIdOrNull("line", c.line);
        fieldIdOrNull("hint", c.hint);
        fieldIdOrNull("context", c.context, /*comma=*/false);
        std::fputs(i + 1 < kCreatureCount ? "},\n" : "}\n", stdout);
    }
    std::fputs("],\n", stdout);
}

void dumpEggLines() {
    std::fputs("\"eggLines\": [\n", stdout);
    for (int i = 0; i < kEggLinesCount; ++i) {
        const EggLineDef& e = kEggLines[i];
        std::fputs("  {", stdout);
        field("id", e.id);
        field("name", e.displayName);
        field("eggCreatureId", e.eggCreatureId, /*comma=*/false);
        std::fputs(i + 1 < kEggLinesCount ? "},\n" : "}\n", stdout);
    }
    std::fputs("],\n", stdout);
}

void dumpItems() {
    std::fputs("\"items\": [\n", stdout);
    for (int i = 0; i < kItemsCount; ++i) {
        const ItemDef& d = kItems[i];
        std::fputs("  {", stdout);
        field("id", d.id);
        field("name", d.displayName);
        field("type", itemTypeKey(d.type));
        field("rarity", rarityName(d.rarity));
        // The expanded description + the derived stat line: exactly the two strings
        // the device's own detail screen draws.
        field("effect", effectText(d).c_str());
        field("stats", statLine(d).c_str());
        field("context", contextKey(d.context));
        field("use", useKey(d.use));
        fieldInt("bits", d.bitsPrice);
        fieldInt("combatHeal", d.combatHeal);
        fieldInt("preEncounterXp", d.preEncounterXp, /*comma=*/false);
        std::fputs(i + 1 < kItemsCount ? "},\n" : "}\n", stdout);
    }
    std::fputs("],\n", stdout);
}

void dumpMods() {
    std::fputs("\"mods\": [\n", stdout);
    for (int i = 0; i < kModsCount; ++i) {
        const ModDef& d = kMods[i];
        std::fputs("  {", stdout);
        field("id", d.id);
        field("name", d.displayName);
        field("tag", d.effectTag);
        field("effect", effectText(d).c_str());
        field("stats", statLine(d).c_str());
        field("rarity", rarityName(d.rarity));
        fieldInt("tier", d.powerTier);
        // The player-facing gate. Authored per row and not derivable from the tier, so it
        // has to travel on the wire — there is no formula the 'Pedia could recover it from.
        fieldInt("equipLevel", modEquipLevel(d));
        fieldBool("oneShot", d.oneShot);
        fieldIdOrNull("line", d.line);
        fieldIdOrNull("requiresLine", d.requiresLine, /*comma=*/false);
        std::fputs(i + 1 < kModsCount ? "},\n" : "}\n", stdout);
    }
    std::fputs("],\n", stdout);
}

// The EXPL ladder, in order. Published so the generator can label a mod by WHERE it
// drops without keeping its own copy of the ladder in Python — a copy that goes quietly
// wrong the moment an area is inserted or reordered, since a rank is a ladder position
// and nothing in the site would notice the two disagreeing. `tier` is areaTier's derived
// depth, which is what a mod's own `tier` field above is comparable against.
void dumpAreas() {
    std::fputs("\"areas\": [\n", stdout);
    for (int i = 0; i < kAreaCount; ++i) {
        const AreaDef& a = area(i);
        std::fputs("  {", stdout);
        field("id", a.id);
        field("name", a.name);
        fieldInt("tier", areaTier(i));
        field("title", a.title, /*comma=*/false);
        std::fputs(i + 1 < kAreaCount ? "},\n" : "}\n", stdout);
    }
    std::fputs("],\n", stdout);
}

void dumpMoves() {
    std::fputs("\"moves\": [\n", stdout);
    for (int i = 0; i < kMovesCount; ++i) {
        const MoveDef& d = kMoves[i];
        std::fputs("  {", stdout);
        field("id", d.id);
        field("name", d.displayName);
        field("kind", moveKindTag(d.kind));
        fieldInt("power", d.power);
        fieldInt("turns", d.channelTurns);
        field("effect", effectText(d).c_str());
        field("stats", statLine(d).c_str());
        field("minStage", stageKey(d.minStage));
        fieldIdOrNull("line", d.line, /*comma=*/false);
        std::fputs(i + 1 < kMovesCount ? "},\n" : "}\n", stdout);
    }
    std::fputs("],\n", stdout);
}

// The MERGE HUB table. Ids only — an ingredient id IS an item id, and the site already
// has the item table, so resolving names here would put a second copy of every dish name
// in the data file for the generator to keep in step. What only the firmware knows is the
// ROW: which dish a method makes, what it costs, and which dish it wants met first.
//
// No `wire`: that number is a save-bit identity, meaningless off-device, and publishing
// it would invite the site to key on it. The output id is the table's own key
// (recipeIndexByOutput), and it is an item id the site can join on.
void dumpRecipes() {
    std::fputs("\"recipes\": [\n", stdout);
    for (int i = 0; i < kMergeRecipeCount; ++i) {
        const MergeRecipe& r = kMergeRecipes[i];
        std::fputs("  {", stdout);
        field("name", r.displayName);
        field("output", r.outputId);
        fieldInt("outputQty", r.outputQty);

        std::fputs("\"inputs\": [", stdout);
        bool first = true;
        for (const RecipeInput& in : r.inputs) {
            if (!in.id) continue;
            if (!first) std::fputs(", ", stdout);
            first = false;
            std::fputs("{", stdout);
            field("id", in.id);
            fieldInt("qty", in.qty, /*comma=*/false);
            std::fputs("}", stdout);
        }
        std::fputs("], ", stdout);

        // The met-the-dish gate, empty on most rows.
        std::fputs("\"requires\": [", stdout);
        first = true;
        for (const char* id : r.requiresItems) {
            if (!id) continue;
            if (!first) std::fputs(", ", stdout);
            first = false;
            jstr(id);
        }
        std::fputs("]", stdout);
        std::fputs(i + 1 < kMergeRecipeCount ? "},\n" : "}\n", stdout);
    }
    std::fputs("],\n", stdout);
}

// The achievement catalogue. `trigger` goes out ALREADY EXPANDED — the row writes `{n}`
// and the resolved goal is substituted here (app/game_achievements.h), so a kGoalAll row
// publishes the real set size and the site never has to know what the sentinel means.
void dumpAchievements() {
    std::fputs("\"achievements\": [\n", stdout);
    for (int i = 0; i < kAchievementCount; ++i) {
        const AchievementDef& d = kAchievements[i];
        std::fputs("  {", stdout);
        field("key", d.id);
        field("name", d.displayName);
        field("trigger", achievementTrigger(d).c_str());
        field("icon", d.icon);
        fieldInt("goal", achievementGoal(d));
        fieldBool("hidden", d.hidden, /*comma=*/false);
        std::fputs(i + 1 < kAchievementCount ? "},\n" : "}\n", stdout);
    }
    std::fputs("]\n", stdout);
}

}  // namespace

int main() {
    std::fputs("{\n", stdout);
    dumpCreatures();
    dumpEggLines();
    dumpItems();
    dumpMods();
    dumpAreas();
    dumpMoves();
    dumpRecipes();
    dumpAchievements();
    std::fputs("}\n", stdout);
    return 0;
}
